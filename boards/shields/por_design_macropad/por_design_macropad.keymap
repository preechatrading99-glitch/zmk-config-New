keymap {
  compatible = "zmk,keymap";
  description = "POR-Design Macropad 5x6 default layout";
  bindings = <
    &kp KC_ESC    &kp KC_1    &kp KC_2    &kp KC_3    &kp KC_4    &kp KC_5
    &kp KC_TAB    &kp KC_Q    &kp KC_W    &kp KC_E    &kp KC_R    &kp KC_T
    &kp KC_LCTL   &kp KC_A    &kp KC_S    &kp KC_D    &kp KC_F    &kp KC_G
    &kp KC_LSFT   &kp KC_Z    &kp KC_X    &kp KC_C    &kp KC_V    &kp KC_B
    &kp KC_SPC    &kp KC_LALT &kp KC_LGUI &kp KC_ENT  &kp KC_BSPC &kp KC_DEL
  >;
  layers = <0>;
};